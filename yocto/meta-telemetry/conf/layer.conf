## yocto/meta-telemetry/conf/layer.conf
```bitbake
# Layer configuration for meta-telemetry.
# Add this layer with: bitbake-layers add-layer ../meta-telemetry

BBPATH .= ":${LAYERDIR}"
BBFILES += "${LAYERDIR}/recipes-*/*/*.bb ${LAYERDIR}/recipes-*/*/*.bbappend"

BBFILE_COLLECTIONS += "meta-telemetry"
BBFILE_PATTERN_meta-telemetry = "^${LAYERDIR}/"
BBFILE_PRIORITY_meta-telemetry = "10"

LAYERDEPENDS_meta-telemetry = "core"
LAYERSERIES_COMPAT_meta-telemetry = "nanbield scarthgap"
```
